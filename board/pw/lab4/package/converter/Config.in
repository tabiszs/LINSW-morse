## board/pw/lab4/package/converter/Config.in
```kconfig
config BR2_PACKAGE_MORSE_CONVERTER
	bool "converter"
	help
	  App to convert text into morse code
```

## board/pw/lab4/package/morse/Config.in
```kconfig
config BR2_PACKAGE_MORSE
	bool "morse"
	depends on BR2_PACKAGE_LIBGPIOD
	help
	  Morse code transmiter

comment "morse depends on gpiod library"
	depends on !BR2_PACKAGE_LIBGPIOD
```

## buildroot/package/worms/Config.in
```kconfig
config BR2_PACKAGE_WORMS
	bool "worms"
	depends on BR2_PACKAGE_NCURSES
	help
	  Game worms using ncurses

	  http://www.paulgriffiths.net/program/c/curworm.php

comment "worms depends on ncurses library"
	depends on !BR2_PACKAGE_NCURSES
```
